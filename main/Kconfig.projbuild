## main/Kconfig.projbuild
```kconfig
menu "WiFi Sniffer Configuration"

    config WIFI_SNIFFER_DEFAULT_CHANNEL
        int "Default WiFi Channel"
        range 1 13
        default 1
        help
            Default WiFi channel to start sniffing on.
            Valid range is 1-13 for 2.4GHz WiFi.

    config WIFI_SNIFFER_CHANNEL_SWITCH_INTERVAL
        int "Channel Switch Interval (ms)"
        range 1000 60000
        default 5000
        help
            Time in milliseconds between automatic channel switches.
            Set to 0 to disable channel hopping.

    config WIFI_SNIFFER_MAX_PACKET_SIZE
        int "Maximum Packet Size to Send"
        range 32 2048
        default 64
        help
            Maximum number of bytes from each packet to send via USB.
            Smaller values reduce USB bandwidth usage.

endmenu
```

## sdkconfig.defaults
```kconfig
# Target ESP32-S3
CONFIG_IDF_TARGET="esp32s3"
CONFIG_IDF_TARGET_ESP32S3=y


# ===== Console / Logging =====
# Use CP2102N (UART0) as console/monitor. Keep logs modest to avoid noise.
CONFIG_ESP_CONSOLE_UART_DEFAULT=y
CONFIG_ESP_CONSOLE_USB_SERIAL_JTAG=n
CONFIG_LOG_DEFAULT_LEVEL_INFO=y

# ===== TinyUSB (native USB on GPIO20/19) =====
# Enable TinyUSB device stack and CDC-ACM for capture COM port.
CONFIG_TINYUSB_ENABLED=y
CONFIG_TINYUSB_DEVICE_ENABLED=y
CONFIG_TINYUSB_CDC_ENABLED=y



# ===== PSRAM (if your module has it; safe to keep enabled) =====
CONFIG_SPIRAM=y
CONFIG_SPIRAM_MODE_OCT=y
CONFIG_SPIRAM_USE_MALLOC=y
CONFIG_SPIRAM_MALLOC_ALWAYSINTERNAL=0
CONFIG_SPIRAM_FETCH_INSTRUCTIONS=y
CONFIG_SPIRAM_RODATA=y
CONFIG_SPIRAM_SPEED_80M=y

# ===== RTOS tick (sniffing benefits from finer granularity) =====
CONFIG_FREERTOS_HZ=1000

# Wi-Fi
CONFIG_ESP_WIFI_ENABLED=y
CONFIG_ESP_WIFI_SSID_SCAN_AUTHENTICATION=y
CONFIG_ESP_WIFI_SOFTAP_SUPPORT=y

# compiler
CONFIG_COMPILER_OPTIMIZATION_PERF=y

# ESPTOOLPY Serial
CONFIG_ESPTOOLPY_BAUD_OTHER_VAL=921600
CONFIG_ESPTOOLPY_BAUD_921600B=y

# ===== Flash settings (adjust to your board if needed) =====
CONFIG_ESPTOOLPY_FLASHSIZE_8MB=y
CONFIG_ESPTOOLPY_FLASHSIZE="8MB"
CONFIG_ESPTOOLPY_FLASHMODE_DIO=y
CONFIG_ESPTOOLPY_FLASHFREQ_80M=y
```
